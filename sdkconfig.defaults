## sdkconfig.defaults
```kconfig
# CONFIG_ESP_MAIN_TASK_STACK_SIZE=8192
# CONFIG_ESP_SYSTEM_EVENT_TASK_STACK_SIZE=4096
# CONFIG_FREERTOS_IDLE_TASK_STACKSIZE=4096
# CONFIG_PTHREAD_TASK_STACK_SIZE_DEFAULT=4096
# CONFIG_FREERTOS_HZ=1000
# 
# # Bluetooth - ESP32-C6 BLE only controller
# CONFIG_BT_ENABLED=y
# CONFIG_BT_CONTROLLER_ONLY=y
# CONFIG_BT_LE_MAX_CONNECTIONS=3
# CONFIG_BT_CTRL_BLE_ADV_REPORT_FLOW_CTRL_SUPP=y
# CONFIG_BT_CTRL_BLE_ADV_REPORT_FLOW_CTRL_NUM=100
# 
# # Bluepad32
# CONFIG_BLUEPAD32_MAX_DEVICES=4
# CONFIG_BLUEPAD32_PLATFORM_CUSTOM=y
# CONFIG_BLUEPAD32_USB_CONSOLE_ENABLE=n
# 
# # BTstack
# CONFIG_BTSTACK_AUDIO=n
# 
# # FreeRTOS
# CONFIG_FREERTOS_USE_TRACE_FACILITY=y
# CONFIG_FREERTOS_USE_STATS_FORMATTING_FUNCTIONS=y
CONFIG_ESP_MAIN_TASK_STACK_SIZE=8192
CONFIG_ESP_SYSTEM_EVENT_TASK_STACK_SIZE=4096
CONFIG_FREERTOS_IDLE_TASK_STACKSIZE=4096
CONFIG_PTHREAD_TASK_STACK_SIZE_DEFAULT=4096
CONFIG_FREERTOS_HZ=1000
# Bluetooth - ESP32-S3 BLE controller
CONFIG_BT_ENABLED=y
CONFIG_BT_CONTROLLER_ENABLED=y
CONFIG_BT_BLUEDROID_ENABLED=n
CONFIG_BT_NIMBLE_ENABLED=n
CONFIG_BT_CONTROLLER_ONLY=y
CONFIG_BT_BLE_ENABLED=y
CONFIG_BT_LE_MAX_CONNECTIONS=3
# Bluepad32
CONFIG_BLUEPAD32_MAX_DEVICES=4
CONFIG_BLUEPAD32_PLATFORM_CUSTOM=y
CONFIG_BLUEPAD32_USB_CONSOLE_ENABLE=n
# BTstack
CONFIG_BTSTACK_AUDIO=n
# FreeRTOS
CONFIG_FREERTOS_USE_TRACE_FACILITY=y
CONFIG_FREERTOS_USE_STATS_FORMATTING_FUNCTIONS=y
```
